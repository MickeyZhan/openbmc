## meta-facebook/meta-galaxy100_backup/conf/machine/galaxy100.conf
```bitbake
#@TYPE: Machine
#@NAME: Wedge100
#@DESCRIPTION: Machine configuration for Facebook Wedge100

UBOOT_MACHINE_galaxy100 = "galaxy100_config"

require conf/machine/include/ast1250.inc

# configuration for preferred version of packages
PREFERRED_VERSION_libipmi = "0.1"
PREFERRED_VERSION_ipmid = "0.1"
PREFERRED_VERSION_rest-api = "0.1"

MACHINE_ESSENTIAL_EXTRA_RDEPENDS += "kernel-module-cpld"
```
